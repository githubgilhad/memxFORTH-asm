	.equ TCB_IP, 0
	.equ TCB_DST, 3
	.equ TCB_RST, 5
	.equ TCB_LST, 7
	.equ TCB_TOS, 9
	.equ TCB_DT, 12
	.equ TCB_TCB_cur, 15
	.equ TCB_STATE, 17
	.equ TCB_BASE, 18
	.equ TCB_HERE, 19
	.equ TCB_TIB_len, 22
	.equ TCB_TIB_cur, 24
	.equ TCB_AIB_len, 26
	.equ TCB_AIB_max, 28
	.equ TCB_AIB_cur, 30
	.equ TCB_WL_ORDER_len, 32
	.equ TCB_WL_CURRENT, 33
	.equ TCB_DataStackFirst, 36
	.equ TCB_DataStackLast, 38
	.equ TCB_ReturnStackFirst, 40
	.equ TCB_ReturnStackLast, 42
	.equ TCB_LStackFirst, 44
	.equ TCB_LStackLast, 46
	.equ TCB_DataStack, 48
	.equ TCB_ReturnStack, 138
	.equ TCB_LStack, 228
	.equ TCB_TIB, 318
	.equ TCB_AIB, 398
	.equ TCB_WL_ORDER, 478
	.equ TCB_something_else, 526
	.equ TCB_SIZE, 530

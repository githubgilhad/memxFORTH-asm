	.equ TCB_IP, 0
	.equ TCB_DST, 3
	.equ TCB_RST, 5
	.equ TCB_LST, 7
	.equ TCB_TOS, 9
	.equ TCB_DT, 12
	.equ TCB_TCB_cur, 15
	.equ TCB_STATE, 17
	.equ TCB_BASE, 18
	.equ TCB_HERE, 19
	.equ TCB_TIB_len, 22
	.equ TCB_TIB_cur, 24
	.equ TCB_TIB_max, 26
	.equ TCB_AIB_len, 28
	.equ TCB_AIB_max, 30
	.equ TCB_AIB_cur, 32
	.equ TCB_WL_ORDER_len, 34
	.equ TCB_WL_CURRENT, 35
	.equ TCB_GETC_CTX, 38
	.equ TCB_DataStackFirst, 40
	.equ TCB_DataStackLast, 42
	.equ TCB_ReturnStackFirst, 44
	.equ TCB_ReturnStackLast, 46
	.equ TCB_LStackFirst, 48
	.equ TCB_LStackLast, 50
	.equ TCB_DataStack, 52
	.equ TCB_ReturnStack, 142
	.equ TCB_LStack, 232
	.equ TCB_TIB, 322
	.equ TCB_AIB, 402
	.equ TCB_WL_ORDER, 482
	.equ TCB_VT, 530
	.equ TCB_something_else, 532
	.equ TCB_SIZE, 536
	.equ VT_read_char, 0
	.equ VT_write_char, 3
	.equ VT_cls, 6
	.equ VT_set_cursor_visible, 9
	.equ VT_set_cursor_char, 12
	.equ VT_set_cursor_X, 15
	.equ VT_set_cursor_Y, 18
	.equ VT_set_cursor_XY, 21
	.equ VT_put_char_XY, 24
	.equ VT_set_row_color, 27
	.equ VT_set_row_color_Y, 30
	.equ VT_char_at_XY, 33
	.equ VT_MAX_LINES, 36
	.equ VT_MAX_COLUMNS, 39
	.equ VT_wait, 42
	.equ VT_cr, 45
	.equ VT_SIZE, 48
